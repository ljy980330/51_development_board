/*********************************************************************************************************
*名称：Ultrasonic.c
*功能：超声波对应的函数
创建时间：2019/7/8
修改时间：2019/7/8
作者：黄彦钊
*********************************************************************************************************/
#include <STC12C5A.H>  
#include <stdio.h>		
#include "config.h"	
#include "delay/delay.h"
#include "Ultrasonic.h"
sbit Echo=P3^2;
sbit Trig=P3^7;		 
uint time=0;
float distance=0;
/*******************************************************************************
* 函 数 名         : conut
* 函数功能		   : 处理并显示距离
*******************************************************************************/ 
void conut(void)
{
 time=TH0*256+TL0;
 TH0=0;
 TL0=0;
 distance=(time*1.88)/10;     //算出来是MM
 printf("distance=%f\n",distance);
}	   
/*******************************************************************************
* 函 数 名         : timer_Count											  
* 函数功能		   : 计时初始化
*******************************************************************************/ 
void timer_Count(void)
{
	 TR0=1;			    //开启计数
     while(Echo);			//当Echo为1计数并等待
     TR0=0;				//关闭计数
     conut();			//计算

}			   		  
/*******************************************************************************
* 函 数 名         : timer_Count											  
* 函数功能		   : 每过800ms启动一次模块
*******************************************************************************/ 
void  startModule() 		         //用来扫描数码管和计800MS启动模块
{
  Trig=1;			                 
  nop(20); 
  Trig=0;
}
		
/*******************************************************************************
* 函 数 名         : init											  
* 函数功能		   : 定时器初始化
*******************************************************************************/ 
void init()
{
	TMOD=0x21;		   //T1方式2，T0方式1
	SCON=0x50;

	TH0=0;
	TL0=0; 
	TR0=1;  		   //开启定时器T0
	ET0=1;             //允许T0中断		

	TH1=0xFD;
	TL1=0xFD;
	TR1=1;			   //开启定时器T1
	TI=1;
	
	EA=1;			   //开启总中断
}
		  
/*******************************************************************************
* 函 数 名         : run										  
* 函数功能		   : 启动程序
*******************************************************************************/ 
void run()
{			  
	uint valA;
	delay_ms(60);
	Echo=1;
    startModule();
    for(valA=7510;valA>0;valA--)
    {
       if(Echo==1)
	   {
       timer_Count();
	   }
	 }
}