/*********************************************************************************************************
*名称：function.c
*功能：对OLED功能设置
创建时间：2019/7/5
修改时间：2019/XX/XX
作者：XXX
**********************************************************************************************************/

#include "function.h"	 
#include "../i2c/i2c.h"

/*******************************************************************************
* 函 数 名         : OLED_WrCmd
* 函数功能		   : OLED写命令
*******************************************************************************/

void OLED_WrCmd(uchar IIC_Command)
{
	IIC_Start();

	Write_IIC_Byte(0x78);          

	Write_IIC_Byte(0x00);		

	Write_IIC_Byte(IIC_Command);

	IIC_Stop();
}

/*******************************************************************************
* 函 数 名         : OLED_WrDat
* 函数功能		   : OLED写数据
*******************************************************************************/

void OLED_WrDat(uchar IIC_Data)
{
	IIC_Start();

	Write_IIC_Byte(0x78);

	Write_IIC_Byte(0x40);			//write data

	Write_IIC_Byte(IIC_Data);

	IIC_Stop();
}

/*******************************************************************************
* 函 数 名         : OLED_Set_pos
* 函数功能		   : OLED设置坐标
*******************************************************************************/

void OLED_Set_Pos(uchar x, uchar y) 
{ 
	OLED_WrCmd(0xb0+y);

	OLED_WrCmd(((x&0xf0)>>4)|0x10);

	OLED_WrCmd((x&0x0f)|0x01);
} 


/*******************************************************************************
* 函 数 名         : OLED_Fill
* 函数功能		   : OLED全屏
*******************************************************************************/

void OLED_Fill(uchar bmp_dat) 
{
	uchar y,x;
	for(y=0;y<8;y++)
	{
		OLED_WrCmd(0xb0+y);

		OLED_WrCmd(0x01);

		OLED_WrCmd(0x10);

		for(x=0;x<X_WIDTH;x++)

		OLED_WrDat(bmp_dat);
	}
}


/*******************************************************************************
* 函 数 名         : OLED_CLS
* 函数功能		   : OLED复位
*******************************************************************************/

void OLED_CLS(void)
{
	uchar y,x;
	for(y=0;y<8;y++)
	{
		OLED_WrCmd(0xb0+y);

		OLED_WrCmd(0x01);

		OLED_WrCmd(0x10);

		for(x=0;x<X_WIDTH;x++)

		OLED_WrDat(0);
	}
}


