/******************************
*	名称：PWM.c
	功能：初始化PWM，设定占空比输出
 	修改时间：2019年7月27日
    作者：曾思茹	   
******************************/

#include <STC12C5A.H>
unsigned char CCAP[10]={16,32,64,80,128,150,180,200,228,250}; //用于调配占空比

/************************************/
/*		函数名：Init_PWM		    */
/*									*/
/************************************/

void Init_PWM()         //  PWM功能的初始化
{
    CMOD = 0X02;        //  设置脉冲源	 系统时钟2
 
    CCAPM0 = 0X42;      //  开启比较器，允许输出脉宽调制信号
    PCA_PWM0 = 0X00;    //  组成9位比较器
    CCAP0L = 0x80;      //  比较器中的初值
    CCAP0H = 0X80;      //  比较器初值
    CL=0;   //  装载值为0
    CR =1;  //  启动计数模式
}
/****************************************************/
/*                   延时函数                       */
/*			函数名：PWM_dalay						*/
/****************************************************/  
void PWM_dalay()
{
	int a=4000;
	while(--a);
	while(--a);
/*之所以循环两次是因为延时时间不够转换速度太快现象会没那么明显*/
}


/****************************************************/
/*         赋值给CCAP0H用于改变占空比               */
/*          函数名：PWM_change    		     		*/
/****************************************************/
void PWM_change()
{
	int i;
	for(i=0;i<10;i++)
	{
		CCAP0H=CCAP[i];	//调节占空比
		PWM_dalay();
	}

}