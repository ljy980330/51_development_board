/*********************************************************************************************************
*名称：FengMingQi.h
*功能：蜂鸣器所用到函数
创建时间：2019/7/5
修改时间：2019/7/5
作者：黄剑桥
*********************************************************************************************************/
#include "buzz.h"
U16 n=0;
 U16 code music_tab[] ={   
0x18, 0x30, 0x1C , 0x10, //格式为: 频率常数, 节拍常数, 频率常数, 节拍常数,    
0x20, 0x40, 0x1C , 0x10,   
0x18, 0x10, 0x20 , 0x10,   
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0x18, 0x80, 0x00   
};

/**********************************************************
函数：int0()
功能：采用中断0 控制节拍
*************************************************************/
 void int0()  interrupt 1       
{  TH0=0xd8;   
   TL0=0xef;   
   n--;   
}   

/******************************************************************************
*函数名： fengming
*功能： 使蜂鸣器发出声音
******************************************************************************/

void Feng_Ming_Qi()	  
{ 
    U16 p,m;   //m为频率常数变量    
    U16 i=0;   
    TMOD&=0x0f;   
    TMOD|=0x01;   
    TH0=0xd8;TL0=0xef;   
    IE=0x82;   
   play: 
    while(1)   
    {   
     a:p=music_tab[i];   
       if(p==0x00)       { i=0, Delay_us(1000); goto play;}     //如果碰到结束符,延时1秒,回到开始再来一遍，程序回到paly标志的地方    
       else if(p==0xff)  { i=i+1;Delay_us(100),TR0=0; goto a;}  //若碰到休止符,延时100ms,继续取下一音符，程序回到a标志的地方    
            else         {m=music_tab[i++], n=music_tab[i++];}  //取频率常数 和 节拍常数    
             TR0=1;                                             //开定时器1    
           while(n!=0) buzz=~buzz,delay_pinglu(m);                         //等待节拍完成, 通过P1口输出音频(可多声道哦!)    
       TR0=0;                                             //关定时器1    
    }   
}