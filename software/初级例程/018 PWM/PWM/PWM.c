/******************************
*	名称：PWM.c
	功能：初始化PWM与独立按键
	根据按键加减PWM输出占空比
	创建时间：2019/7/27
 	修改时间：2019年7/29
    作者：曾思茹	   
******************************/#include <STC12C5A.H>
#include "delay/delay.h"
#include "config.h"
sbit k1=P4^5;
sbit k2=P4^6; //定义独立按键管脚


/**********************************************
* 	名称：init
*	作用：初始化PWM，声明独立按键的特殊寄存器
**********************************************/

void Init()         //  PWM功能的初始化
{
    CMOD = 0X02;        //  设置脉冲源	 系统时钟2
 
    CCAPM0 = 0X42;      //  开启比较器，允许输出脉宽调制信号
    PCA_PWM0 = 0X00;    //  组成9位比较器
    CCAP0L = 0x80;      //  比较器中的初值
    CCAP0H = 0X80;      //  比较器初值
    CL=0;   //  装载值为0
    CR =1;  //  启动计数模式

	/*以下是定义按键IO口寄存器的声明*/
	P4SW=0xbb;
	P4M1=0x00;
 	P4M0=0x72; 
	P4SW=0x70;
}

/***************************
*	名称：PWM_plus
*	作用：增加函数占空比
***************************/
void PWM_plus(uchar k)
{		
	CCAP0H = k;
}

/***************************
*	名称：PWM_plus
*	作用：减小函数占空比
***************************/
void PWM_minus(uchar x)
{
	CCAP0H = x;
}


/*********************************************************
* 	名称: key
* 	作用: 按键处理函数，判断按键是否按下
*********************************************************/
void key()
{
	static uchar temp=0;
	if(k1==0)		  //检测按键K1是否按下
	{	
		delay_us(1000);   //消除抖动 一般大约10ms
		if(k1==0)	 //再次判断按键是否按下
		{
			temp += 5;
			PWM_plus(temp);	 //增加占空比 
		}
		while(!k1);	 //检测按键是否松开
	}
	if(k2==0)		  //检测按键K2是否按下
	{	
		delay_us(1000);   //消除抖动 一般大约10ms
		if(k2==0)	 //再次判断按键是否按下
		{
			temp -= 5;
			PWM_minus(temp);	//减小占空比	  
		}
		while(!k2);	 //检测按键是否松开
	}		
}

