/*********************************************************************************************************
*名称：dcMotor.c
*功能：直流电机对应的函数
创建时间：2019/7/4
修改时间：2019/7/27
作者：曾思茹
*********************************************************************************************************/
#include <STC12C5A.H>
#include <intrins.h> 
unsigned char CCAP[15]={0,2,5,8,16,32,45,64,88,100,128,150,180,220,240}; //用于调配占空比


/*******************************************************************************
* 函 数 名         : Init_PWM
* 函数功能		   : PWM功能的初始化
*******************************************************************************/ 

void Init_PWM()        
{
    CMOD = 0X02;        //  设置脉冲源	 系统时钟2
 
    CCAPM0 = 0X42;      //  开启比较器，允许输出脉宽调制信号
    PCA_PWM0 = 0X00;    //  组成9位比较器
    CCAP0L = 0x80;      //  比较器中的初值
    CCAP0H = 0X80;      //  比较器初值
    CL=0;   //  装载值为0
    CR =1;  //  启动计数模式
}
 

/*******************************************************************************
* 函 数 名         : Init_PWM  moto_delay80ms
* 函数功能		   : 延迟80ms
*******************************************************************************/ 
void moto_delay80ms()   //误差 -0.00000000001us
{
    unsigned char a,b,c;
    for(c=58;c>0;c--)
        for(b=151;b>0;b--)
            for(a=49;a>0;a--);
    _nop_();  
}

/*******************************************************************************
* 函 数 名         : PWM_change  
* 函数功能		   : 赋值给CCAP0H用于改变占空比 
*******************************************************************************/ 
void PWM_change()
{
	int i;
	for(i=0;i<12;i++)
	{
		CCAP0H=CCAP[i];	//改变占空比
		moto_delay80ms();
	}

}