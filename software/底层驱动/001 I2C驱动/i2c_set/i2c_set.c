/*********************************************************************************************************
*名称：i2c_set.c
*功能：	i2c初始化以及信号发送和主从机应答
创建时间：2019/7/5
修改时间：2019/XX/XX
作者：XXX
**********************************************************************************************************/

#include "i2c_set.h"

/*******************************************************************************
* 函 数 名         : IIC_Init
* 函数功能		   : i2c初始化
*******************************************************************************/

void IIC_Init()	
{
	SCL = high;
	nop();
	SDA = high;
	nop();
}


/*******************************************************************************
* 函 数 名         : IIC_Start
* 函数功能		   : i2c起始信号
*******************************************************************************/

void IIC_Start()  
{
	SDA = high;
	nop();
	SCL = high;
	nop();
	SDA = low;
	nop();
	SCL = low;
	nop();
}


/*******************************************************************************
* 函 数 名         : IIC_Stop
* 函数功能		   : i2c终止信号
*******************************************************************************/

void IIC_Stop()
{
	SCL = low;
	nop();
	SDA = low;
	nop();
	SCL = high;
	nop();
	SDA = high;
	nop();
}


/*******************************************************************************
* 函 数 名         : Write_IIC_Byte
* 函数功能		   : 通过I2C总线写一个字节
*******************************************************************************/

void Write_IIC_Byte(U8 IIC_Byte)
{
	U8 i;

	for(i=0;i<8;i++)
	{
		if(IIC_Byte & 0x80)
			SDA=high;
		else
			SDA=low;

		SCL=high;

		SCL=low;

		IIC_Byte<<=1;
	}
	SDA=low;
	nop();
	SCL=high;
	nop();
	SCL=low;
}



/*******************************************************************************
* 函 数 名         : Read_IIC_Byte
* 函数功能		   : 读取一个字节
*******************************************************************************/

U8 Read_IIC_Byte()   
{
   U8 i, j;
   U8 k = 0;
   SCL = low; 
   nop(); 
   SDA = high;
   for (i=0; i<8; i++)
   {  
		nop(); 
		SCL = high; 
		nop();
      	if(SCL == high) 
			j = 1;
      	else
			j = 0;
      	k = (k<<1)|j;
	  	SCL = 0;
	}
   	nop();
	return(k);
}


/*******************************************************************************
* 函 数 名         : Clock
* 函数功能		   : i2c总线时钟
*******************************************************************************/

void Clock()
{
	U8 i = 0;
	SCL = high;
	nop();
	while((SDA == high) && (i < 255))
		i++;
	SCL = low;
	nop();

}

