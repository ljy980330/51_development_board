/*********************************************************************************************************
*名称：spi.c
*功能：iic包括的函数
创建时间：2019/XX/XX
修改时间：2019/6/5
作者：XXX
*********************************************************************************************************/
#include <STC12C5A.H> 
#include "spi.h"
#include "config.h"	
#include "delay/delay.h"

sbit SPICLK = P1^0; //时钟信号 
sbit MOSI = P1^1; //主器件数据输出，从器件数据输入 
sbit MISO = P1^2; //主器件数据输入，从器件数据输出 
sbit SS = P1^3; //从器件使能信号 //--------------------------- 	  
uchar exdat; 
uchar i=0; 
uchar code table[10]={0x3F,0x06,0x5B,0x4F,0x66,0x6D,0x7D,0x07, 0x7F,0x6F}; 					   
/*******************************************************************************
* 函 数 名         : Data_Receive
* 函数功能		   : 数据接收程序
*******************************************************************************/
uchar Data_Receive()  
{ 
	uchar i,dat=0,temp; 
	bit bt; 
	SPICLK=1; 
	MISO=1; 
	SS=0; //选中器件 
	nop(2); 
	for(i=0;i<8;i++) 
	{ 
		SPICLK=1; 
		nop(3);
		SPICLK=0; 
		nop(2); 
		bt=MISO; 
		if(bt) 
			temp=0x01;
		else 
			temp=0x00; 
		dat=(dat<<1); 
		dat=(dat|temp); 
	} 
	SS=1; 
	SPICLK=1; 
	return dat; 
}	   		  
/*******************************************************************************
* 函 数 名         : run
* 函数功能		   : 主程序启动函数
*******************************************************************************/
void run()
{
	exdat=Data_Receive(); 
	P0=table[exdat]; 
	for(i=0;i<200;i++)
	delay_us(200); 
}