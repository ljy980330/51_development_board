/*********************************************************************************************************
*名称：i2c.c
*功能：	i2c初始化以及信号发送和主从机应答
创建时间：2019/7/5
修改时间：2019/XX/XX
作者：XXX
**********************************************************************************************************/

#include "i2c.h"

/*******************************************************************************
* 函 数 名         : I2C_Init
* 函数功能		   : i2c初始化
*******************************************************************************/

void I2C_Init()	
{
	SCL = high;
	nop(1);
	SDA = high;
	nop(1);
}


/*******************************************************************************
* 函 数 名         : I2C_Start
* 函数功能		   : i2c起始信号
*******************************************************************************/

void I2C_Start()  
{
	SDA = high;
	nop(1);
	SCL = high;
	nop(1);
	SDA = low;
	nop(1);
	SCL = low;
	nop(1);
}


/*******************************************************************************
* 函 数 名         : I2C_Stop
* 函数功能		   : i2c终止信号
*******************************************************************************/

void I2C_Stop()
{
	SCL = low;
	nop(1);
	SDA = low;
	nop(1);
	SCL = high;
	nop(1);
	SDA = high;
	nop(1);
}


/*******************************************************************************
* 函 数 名         : Write_I2C_Byte
* 函数功能		   : 通过I2C总线写一个字节
*******************************************************************************/

void Write_I2C_Byte(uchar I2C_Byte)
{
	uchar i;

	for(i=0;i<8;i++)
	{
		if(I2C_Byte & 0x80)
			SDA=high;
		else
			SDA=low;

		SCL=high;

		SCL=low;

		I2C_Byte<<=1;
	}
	SDA=low;
	nop(1);
	SCL=high;
	nop(1);
	SCL=low;
}



/*******************************************************************************
* 函 数 名         : Read_I2C_Byte
* 函数功能		   : 读取一个字节
*******************************************************************************/

uchar Read_I2C_Byte()   
{
   uchar i, j;
   uchar k = 0;
   SCL = low; 
   nop(1); 
   SDA = high;
   for (i=0; i<8; i++)
   {  
		nop(1); 
		SCL = high; 
		nop(1);
      	if(SCL == high) 
			j = 1;
      	else
			j = 0;
      	k = (k<<1)|j;
	  	SCL = 0;
	}
   	nop(1);
	return(k);
}


/*******************************************************************************
* 函 数 名         : Clock
* 函数功能		   : i2c总线时钟
*******************************************************************************/

void Clock()
{
	uchar i = 0;
	SCL = high;
	nop(1);
	while((SDA == high) && (i < 255))
		i++;
	SCL = low;
	nop(1);

}	 
/*******************************************************************************
* 函 数 名         : Ack_I2C
* 函数功能		   : 发出应答或非应答信号
*******************************************************************************/
void Ack_I2C(bit a) 
{ 
	if(a==0) 
		SDA=0; //在此发出应答或非应答信号 
	else 
		SDA=1; 
	delay_us(3); 
	SCL=1; 
	delay_us(5); //时钟低电平周期大于4μs 
	SCL=0; //清时钟线，钳住I2C总线以便继续接收 
	delay_us(2); 
}  

