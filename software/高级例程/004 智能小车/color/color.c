/*********************************************************************************************************
*名称：color.c
*功能：灯光功能所用到的函数
创建时间：2019/7/8
修改时间：2019/7/8
作者：黄彦钊
*********************************************************************************************************/

#include <intrins.h>
#include "color.h"	
#include "delay/delay.h"
sbit Send_Dat=P2^6;	  
uchar RGB_BUF[24];

/*******************************************************************************
* 函 数 名         : Send_A_bit
* 函数功能		   : 闪烁灯
*******************************************************************************/
void Send_A_bit(unsigned char VAL)
{
	 if(VAL==1)
	 {
	    Send_Dat=1;
		nop(3);
		Send_Dat=0;
		nop(1);
	 }
	 else
	 {
		Send_Dat=1;
		nop(1);
		Send_Dat=0;
		nop(3);
		
	 }
}	   
/*******************************************************************************
* 函 数 名         : Send_24bits
* 函数功能		   : 流水灯
*******************************************************************************/
void Send_24bits(unsigned char R,unsigned char G,unsigned char B)
{
     uchar i,a;
	 for(i=0;i<8;i=i+1)
	 {	 
	     RGB_BUF[i]=B>>i&0x01;
	 }
	 for(i=8;i<16;i=i+1)
	 {
	     RGB_BUF[i]=R>>(i-8)&0x01;
	 }
	 for(i=16;i<24;i=i+1)
	 {
	 	 RGB_BUF[i]=G>>(i-16)&0x01;
	 }
	 for(a=0;a<4;a=a+1)	//这个for循环可以控制亮几个灯
	 {
	    for(i=0;i<24;i=i+1)
	    {
		 Send_A_bit(RGB_BUF[23-i]);
	    }
		    Send_Dat=0;
			nop(4);
	 }
}
