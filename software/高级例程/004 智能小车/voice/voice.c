/*********************************************************************************************************
*名称：voice.c
*功能：语音功能所用到的函数
创建时间：2019/7/8
修改时间：2019/7/8
作者：黄彦钊
*********************************************************************************************************/
#include <STC12C5A.H>	
#include <stdio.h>	  
#include "voice.h"	   
#include "delay/delay.h"
#include "config.h"

#define HEADLEN       5  //数据包头的长度
#define BKM_OFFSET    4  //背景音乐命令偏移
#define LEN_OFFSET    2  //长度字节的偏移量（一般不会超过255字节，因此只使用1字节长度）
#define BKM_MAX      15	 //背景音乐数量

//数据包头（0xFD + 2字节长度 + 1字节命令字 + 1字节命令参数)
uchar head[HEADLEN] = {0xfd,0x00,0x00,0x01,0x00};
uchar nBkm = 0x00;	 
  
/*******************************************************************************
* 函 数 名         : UART_Init
* 函数功能		   : 串口初始化
*******************************************************************************/
void UART_Init(void)
{
	SCON=0xD8 ;   
	TMOD=0x20 ;
	PCON=0x00 ; 	 
	TH1 = 0xFD;	 //晶振为11.059MHZ时，设定串口波特率为9600bit/s，方式3 
	//TH1=0xFA ;   //晶振为22.1184MHZ时，设定串口波特率为9600bit/s，方式3  
	TR1=1;	
}
/*******************************************************************************
* 函 数 名         : SendChar
* 函数功能		   : 串口发送数据
*******************************************************************************/
void SendChar(uchar n)
{
	SBUF = n;
	while (TI==0);//发送数据
	TI=0;
}	
/*******************************************************************************
* 函 数 名         : Speech
* 函数功能		   : 发声程序
*******************************************************************************/
void Speech(uchar *buf)
{
	uchar i = 0;          //循环计数变量
	uchar xor = 0x00;     //校验码初始化
	uchar ch = 0x00;
    uchar len = 0x00;

    while(buf[len++]);

	//发送数据包头(0xFD + 2字节长度 + 1字节命令字 + 1字节命令参数)
	for(i = 0; i < HEADLEN; i++)
	{
		if(i == BKM_OFFSET)
			ch = nBkm << 3; //写入背景音乐
		else if(i == LEN_OFFSET)
			ch = len + 3;
		else
			ch = head[i];

		xor ^= ch;
		SendChar(ch);
		delay_ms(1);
   	}

	//发送文字内容
	for(i = 0; i < len; i++)
	{
		xor ^= buf[i];
		SendChar(buf[i]);
		delay_ms(1);
	}

	SendChar(xor);         //发送校验位

	delay_ms(50);
	//while(BUSY);         //等待合成结束
	delay_ms(50);
}	 
/*******************************************************************************
* 函 数 名         : one
* 函数功能		   : 报位置为花都广场
*******************************************************************************/
void one()
{  
	TR0=0; 
	Speech("现在的位置是花都广场");
	delay_ms(20000);
	TR0=1;
	//delay_ms(5000);
		
}	 
/*******************************************************************************
* 函 数 名         : two
* 函数功能		   : 报位置为白云山
*******************************************************************************/
void two()
{  
	TR0=0;
	Speech("现在的位置是白云山");
	delay_ms(20000);
	TR0=1;
	//delay_ms(5000);
		
}	
/*******************************************************************************
* 函 数 名         : third
* 函数功能		   : 报位置为华南植物园
*******************************************************************************/
void third()
{  
	TR0=0;
	Speech("现在的位置是华南植物园");
	delay_ms(25000);
	TR0=1;
	//delay_ms(5000);
		
}  
/*******************************************************************************
* 函 数 名         : four
* 函数功能		   : 报位置为广东省博物馆
*******************************************************************************/
void four()
{  
	TR0=0; 
	Speech("现在的位置是广东省博物馆");
	delay_ms(30000);
	TR0=1;
	//delay_ms(5000);
		
}  
/*******************************************************************************
* 函 数 名         : five
* 函数功能		   : 报位置为广州塔
*******************************************************************************/
void five()
{  
	TR0=0; 
	Speech("现在的位置是广州塔");
	delay_ms(22000);
	TR0=1;
	//delay_ms(5000);
		
}
/*******************************************************************************
* 函 数 名         : six
* 函数功能		   : 报位置为中山纪念馆
*******************************************************************************/
void six()
{
	TR0=0; 
	Speech("现在的位置是中山纪念馆");
	delay_ms(32000);
	TR0=1;	
}
/*******************************************************************************
* 函 数 名         : seven
* 函数功能		   : 报位置为黄埔军校
*******************************************************************************/
void seven()
{
	TR0=0; 
	Speech("现在的位置是黄埔军校");
	delay_ms(20000);
	TR0=1;
}
/*******************************************************************************
* 函 数 名         : eight
* 函数功能		   : 报位置为长隆动物园
*******************************************************************************/
void eight()
{
	TR0=0; 
	Speech("现在的位置是长隆动物园");
	delay_ms(32000);
	TR0=1;
}
/*******************************************************************************
* 函 数 名         : nine
* 函数功能		   : 报位置为上下九步行街
*******************************************************************************/
void nine()
{
	TR0=0; 
	Speech("现在的位置是上下九步行街");
	delay_ms(42000);
	TR0=1;
}
/*******************************************************************************
* 函 数 名         : ten
* 函数功能		   : 报位置为流溪河国家森林公园
*******************************************************************************/
void ten()
{
	TR0=0; 
	Speech("现在的位置是流溪河国家森林公园");
	delay_ms(52000);
	TR0=1;
}
/*******************************************************************************
* 函 数 名         : eleven
* 函数功能		   : 报位置为华广
*******************************************************************************/
void eleven()
{
	TR0=0; 
	Speech("现在的位置是华广");
	delay_ms(20000);
	TR0=1;
}